## core/boards/qemu_x86.conf
```kconfig
# The addresses are selected for linux<->qemu connectivity
# http://docs.zephyrproject.org/subsystems/networking/qemu_setup.html#networking-with-qemu

CONFIG_MAIN_STACK_SIZE=2048
CONFIG_FLOAT=y
CONFIG_FP_SHARING=y
```
