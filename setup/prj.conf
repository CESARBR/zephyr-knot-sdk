## CMakeLists.txt
```
cmake_minimum_required(VERSION 3.8.2)

# Kconfig options
set(KCONFIG_ROOT $ENV{KNOT_BASE}/core/Kconfig)

# Change dts with sub-partitions and use specific sub-partition to flash code
# Use special dts overlay in case of debugging
if (KNOT_DEBUG)
	set(DTC_OVERLAY_MULTI_SLOT
		$ENV{KNOT_BASE}/core/boards/${BOARD}-sub-slots-debug.dts
	)

	# Add debug conf file if there is any
	set(DEBUG_OVERLAY $ENV{KNOT_BASE}/setup/boards/${BOARD}-debug.conf)
	if(EXISTS ${DEBUG_OVERLAY})
		set(OVERLAY_CONFIG "${OVERLAY_CONFIG} ${DEBUG_OVERLAY}")
	endif()
else()
	set(DTC_OVERLAY_MULTI_SLOT
		$ENV{KNOT_BASE}/core/boards/${BOARD}-sub-slots-stock.dts
	)
endif()
set(DTC_OVERLAY_SET_SLOT
	$ENV{KNOT_BASE}/core/boards/overlay-setup.dts
)
set(DTC_OVERLAY_FILE
	"${DTC_OVERLAY_FILE} ${DTC_OVERLAY_MULTI_SLOT} ${DTC_OVERLAY_SET_SLOT}"
)

include($ENV{ZEPHYR_BASE}/cmake/app/boilerplate.cmake NO_POLICY_SCOPE)
project(knot_setup)

FILE(GLOB app_sources src/*.c)
FILE(GLOB third_party_sources src/third_party/*.c)
set(core_sources
	$ENV{KNOT_BASE}/core/src/ot_config.c
	$ENV{KNOT_BASE}/core/src/clear.c
	$ENV{KNOT_BASE}/core/src/storage.c
)

target_sources(app PRIVATE
		${app_sources}
		${core_sources}
		${third_party_sources}
)

zephyr_include_directories($ENV{KNOT_BASE}/core/src/)
```

## prj.conf
```kconfig
# Ensure a MCUboot-compatible binary is generated.
CONFIG_BOOTLOADER_MCUBOOT=y

# Disable logging to save flash
CONFIG_LOG=n
CONFIG_LOG_IMMEDIATE=n
CONFIG_CONSOLE=n
CONFIG_SERIAL=n
CONFIG_UART_INTERRUPT_DRIVEN=n
CONFIG_UART_CONSOLE=n
CONFIG_PRINTK=n

# Bluetooth services
CONFIG_BT=y
CONFIG_BT_PERIPHERAL=y
CONFIG_BT_DEVICE_NAME="KNoT Thing"
CONFIG_BT_GATT_OT_SETUP=y
CONFIG_BT_ATT_PREPARE_COUNT=3
CONFIG_BT_SMP=y
CONFIG_BT_SETTINGS=n
CONFIG_BT_PRIVACY=y
CONFIG_BT_MAX_PAIRED=3

# Settings
CONFIG_MPU_ALLOW_FLASH_WRITE=y
CONFIG_FLASH=y
CONFIG_FLASH_MAP=y
CONFIG_FLASH_PAGE_LAYOUT=y
CONFIG_SETTINGS=y
CONFIG_FCB=y
CONFIG_SETTINGS_FCB=y

# OpenThread Settings service
CONFIG_SETTINGS_OT=y

# Enable mcumgr.
CONFIG_MCUMGR=y

# Some command handlers require a large stack.
CONFIG_SYSTEM_WORKQUEUE_STACK_SIZE=2048

# Allow for large Bluetooth data packets.
CONFIG_BT_L2CAP_TX_MTU=260
CONFIG_BT_RX_BUF_LEN=260

# Enable the Bluetooth and shell mcumgr transports.
CONFIG_MCUMGR_SMP_BT=y
CONFIG_MCUMGR_SMP_SHELL=n

# Bluetooth support requires a net_buf user_data size >= 7.
CONFIG_NET_BUF_USER_DATA_SIZE=7

# Enable all core commands.
CONFIG_MCUMGR_CMD_FS_MGMT=n
CONFIG_MCUMGR_CMD_IMG_MGMT=y
CONFIG_MCUMGR_CMD_OS_MGMT=n
CONFIG_MCUMGR_CMD_STAT_MGMT=n

# Bootloader
CONFIG_SOC_FLASH_NRF=y
CONFIG_FLASH_HAS_DRIVER_ENABLED=y
CONFIG_SYSTEM_CLOCK_DISABLE=y

# Peripherals usage
CONFIG_GPIO=y

# Reboot
CONFIG_REBOOT=y
```

## boards/knot_mesh-debug.conf
```kconfig
# Logging
CONFIG_LOG=y
CONFIG_LOG_PRINTK=y
CONFIG_LOG_IMMEDIATE=y

CONFIG_KNOT_LOG=y
CONFIG_KNOT_LOG_LEVEL_DEBUG=y

# USB
CONFIG_USB=y
CONFIG_USB_DEVICE_STACK=y
CONFIG_USB_CDC_ACM=y
CONFIG_USB_UART_CONSOLE=y
CONFIG_USB_DEVICE_PRODUCT="KNoT Thing"
CONFIG_USB_MASS_STORAGE=n

# Use console and shell for output
CONFIG_CONSOLE=y
CONFIG_STDOUT_CONSOLE=y

CONFIG_UART_CONSOLE=y
CONFIG_UART_SHELL_ON_DEV_NAME="CDC_ACM_0"

CONFIG_SERIAL=y

# Disable shell input options
CONFIG_LOG_CMDS=n
CONFIG_SHELL=y
CONFIG_SHELL_BACKSPACE_MODE_DELETE=n
CONFIG_SHELL_WILDCARD=n
CONFIG_SHELL_ECHO_STATUS=n
CONFIG_SHELL_METAKEYS=n
CONFIG_SHELL_HELP=n
CONFIG_SHELL_HELP_ON_WRONG_ARGUMENT_COUNT=n
CONFIG_SHELL_HISTORY=n
CONFIG_SHELL_STATS=n
CONFIG_SHELL_CMDS=n
CONFIG_SHELL_CMDS_RESIZE=n
CONFIG_SHELL_BACKEND_SERIAL_INTERRUPT_DRIVEN=n
```

## boards/nrf52840_pca10056-debug.conf
```kconfig
# Logging
CONFIG_LOG=y
CONFIG_LOG_PRINTK=y
CONFIG_LOG_IMMEDIATE=y

CONFIG_KNOT_LOG=y
CONFIG_KNOT_LOG_LEVEL_DEBUG=y

CONFIG_PRINTK=y

CONFIG_CONSOLE=y
CONFIG_SERIAL=y
CONFIG_UART_INTERRUPT_DRIVEN=y
```

## boards/nrf52840_pca10056.conf
```kconfig
# Using all 8 flash pages from storage slot for Settings subsystem
CONFIG_SETTINGS_FCB_NUM_AREAS=8
```

## boards/nrf52840_pca10059-debug.conf
```kconfig
# Logging
CONFIG_LOG=y
CONFIG_LOG_PRINTK=y
CONFIG_LOG_IMMEDIATE=y
CONFIG_PRINTK=y

CONFIG_KNOT_LOG=y
CONFIG_KNOT_LOG_LEVEL_DEBUG=y

# USB
CONFIG_USB=y
CONFIG_USB_DEVICE_STACK=y
CONFIG_USB_CDC_ACM=y
CONFIG_USB_UART_CONSOLE=y
CONFIG_USB_DEVICE_PRODUCT="KNoT Thing"
CONFIG_USB_MASS_STORAGE=n

# Use console and shell for output
CONFIG_CONSOLE=y
CONFIG_STDOUT_CONSOLE=y

CONFIG_UART_CONSOLE=y
CONFIG_UART_SHELL_ON_DEV_NAME="CDC_ACM_0"
CONFIG_UART_INTERRUPT_DRIVEN=y

CONFIG_SERIAL=y

# Disable shell input options
CONFIG_LOG_CMDS=n
CONFIG_SHELL=y
CONFIG_SHELL_BACKSPACE_MODE_DELETE=n
CONFIG_SHELL_WILDCARD=n
CONFIG_SHELL_ECHO_STATUS=n
CONFIG_SHELL_METAKEYS=n
CONFIG_SHELL_HELP=n
CONFIG_SHELL_HELP_ON_WRONG_ARGUMENT_COUNT=n
CONFIG_SHELL_HISTORY=n
CONFIG_SHELL_STATS=n
CONFIG_SHELL_CMDS=n
CONFIG_SHELL_CMDS_RESIZE=n
CONFIG_SHELL_BACKEND_SERIAL_INTERRUPT_DRIVEN=n
```

## boards/nrf52840_pca10059.conf
```kconfig
# Using first 2 flash areas from storage slot for Settings subsystem
CONFIG_SETTINGS_FCB_NUM_AREAS=2
```

## src/main.c
```c
/* main.c - KNoT Setup main entry point */
/*
 * Copyright (c) 2019, CESAR. All rights reserved.
 *
 * Licensed under the Apache License, Version 2.0 (the "License");
 * you may not use this file except in compliance with the License.
 * You may obtain a copy of the License at
 *
 *     http://www.apache.org/licenses/LICENSE-2.0
 *
 * Unless required by applicable law or agreed to in writing, software
 * distributed under the License is distributed on an "AS IS" BASIS,
 * WITHOUT WARRANTIES OR CONDITIONS OF ANY KIND, either express or implied.
 * See the License for the specific language governing permissions and
 * limitations under the License.
 */

#include <zephyr.h>
#include <logging/log.h>
#include <settings/settings.h>
#include <settings/settings_ot.h>
#include <misc/reboot.h>

#include "bt_srv.h"
#include "peripheral.h"
#include "bootloader.h"
#include "storage.h"
#include "ot_config.h"

LOG_MODULE_REGISTER(knot_setup, LOG_LEVEL_DBG);

void main(void)
{
	int err;
	int btn;
	bool ipv6_set;
	bool ot_set;
	bool reset_signal = false;  // Avoid early reseting

	LOG_DBG("Initializing storage services");

	/* Storage service */
	err = storage_init();
	if (err)
		LOG_ERR("Storage service init failed (err %d)", err);

	/* OT Settings storage */
	err = settings_ot_init();
	if (err)
		LOG_ERR("Settings OT init failed (err %d)", err);

	LOG_DBG("Loading stored values");
	err = settings_load();
	if (err)
		LOG_ERR("Settings load failed (err %d)", err);


	LOG_DBG("Selecting application to run");

	/* Check for stored values */
	ipv6_set = storage_is_set(STORAGE_PEER_IPV6);
	if (ipv6_set)
		LOG_DBG("Peer's IPv6 set");
	else
		LOG_DBG("Peer's IPv6 not set");

	err = ot_config_load();
	ot_set = (err == 0); /* OT config loaded. Has OT settings */

	/* Jump to main application if button pressed */
	err = peripheral_init();
	if (err)
		LOG_ERR("Peripheral initialization failed");
	btn = peripheral_btn_status();

	switch (btn) {
	case PERIPHERAL_BTN_PRESSED:
		LOG_DBG("Setup button pressed");
		break;
	case PERIPHERAL_BTN_NOT_PRESSED:
		LOG_DBG("Setup button not pressed");
		break;
	case PERIPHERAL_BTN_ERROR:
	default:
		LOG_ERR("Button reading error!");
	}

	/*
	 * Run Setup App if button pressed or if PAN Settings
	 * not set.
	 */
	if (btn == PERIPHERAL_BTN_PRESSED ||
	    ipv6_set == false || ot_set == false)
		goto setup;

	/* Load Main App */
	err = bootloader_start_main();
	if (err == false) /* Successful load */
		return;

	/* Flag error if Main App not loaded */
	for (;;) {
		LOG_ERR("Failed to load Main App");
		k_sleep(2000);
	}

setup:
	/* Setup Application */
	LOG_DBG("Initializing Setup App");

	/* Init bluetooth services and give access to signal flags */
	err = bt_srv_init(&reset_signal);
	if (err) {
		LOG_ERR("Failed to initialize bluetooth");
		return;
	}

	while (1) {
		bt_srv_toggle_advertising();
		peripheral_toggle_led();

		/* Reset system if signal received */
		if (reset_signal == false)
			continue;

		LOG_INF("Reseting system...");
		k_sleep(2000);
		sys_reboot(SYS_REBOOT_WARM);
	}
}
```

## src/bootloader.c
```c
/* flabootloader.h - Flash driver to control bootload related actions */

/*
 * Copyright (c) 2019, CESAR. All rights reserved.
 *
 * SPDX-License-Identifier: Apache-2.0
 */

#include <zephyr.h>
#include <logging/log.h>

#include "third_party/nrf_bootloader_app_start.h"

LOG_MODULE_REGISTER(bootloader, LOG_LEVEL_DBG);

int bootloader_start_main(void)
{
	LOG_INF("Starting Main application");
	nrf_bootloader_app_start();
	return -1;	/* Return error as not started main application */
}
```

## src/bootloader.h
```c
/* flabootloader.h - Flash driver to control bootload related actions */

/*
 * Copyright (c) 2019, CESAR. All rights reserved.
 *
 * SPDX-License-Identifier: Apache-2.0
 */

int bootloader_start_main(void);
```

## src/bt_srv.c
```c
/* bt_srv.c - Bluetooth services handler */
/*
 * Copyright (c) 2019, CESAR. All rights reserved.
 *
 * Licensed under the Apache License, Version 2.0 (the "License");
 * you may not use this file except in compliance with the License.
 * You may obtain a copy of the License at
 *
 *     http://www.apache.org/licenses/LICENSE-2.0
 *
 * Unless required by applicable law or agreed to in writing, software
 * distributed under the License is distributed on an "AS IS" BASIS,
 * WITHOUT WARRANTIES OR CONDITIONS OF ANY KIND, either express or implied.
 * See the License for the specific language governing permissions and
 * limitations under the License.
 */

#include <zephyr.h>
#include <logging/log.h>

#include <settings/settings.h>
#include <settings/settings_ot.h>

#include <bluetooth/bluetooth.h>
#include <bluetooth/conn.h>
#include <bluetooth/services/setup_ot.h>
#include <mgmt/smp_bt.h>
#include <mgmt/buf.h>

#ifdef CONFIG_MCUMGR_CMD_IMG_MGMT
#include "img_mgmt/img_mgmt.h"
#endif

#include "bt_srv.h"
#include "gatt_inet6.h"
#include "gatt_ctrl.h"
#include "clear.h"

LOG_MODULE_DECLARE(knot_setup, LOG_LEVEL_DBG);

#define ADVERTISING_TOGGLE_MS 500

bool active_conn;

/* Advertise Peer's IPV6 GATT service's UUID  */
static const struct bt_data ad_inet6[] = {
	BT_DATA_BYTES(BT_DATA_FLAGS, (BT_LE_AD_GENERAL | BT_LE_AD_NO_BREDR)),
	BT_DATA_BYTES(BT_DATA_UUID128_SOME,
		      0x70, 0x14, 0x1c, 0xbe, 0xdd, 0xe6, 0x5a, 0xb3,
		      0x8b, 0x49, 0xb4, 0x5d, 0x83, 0x11, 0x60, 0x49),
};

/* Advertise Peer's MCUMGR service's UUID  */
static const struct bt_data ad_mcumgr[] = {
	BT_DATA_BYTES(BT_DATA_FLAGS, (BT_LE_AD_GENERAL | BT_LE_AD_NO_BREDR)),
	BT_DATA_BYTES(BT_DATA_UUID128_SOME,
		      0x84, 0xaa, 0x60, 0x74, 0x52, 0x8a, 0x8b, 0x86,
		      0xd3, 0x4c, 0xb7, 0x1d, 0x1d, 0xdc, 0x53, 0x8d),
};

/* Scan response Control device GATT service's UUID  */
static const struct bt_data scan_resp_ctrl[] = {
	BT_DATA_BYTES(BT_DATA_UUID128_SOME,
		      0x70, 0xba, 0x2b, 0xfb, 0x05, 0x74, 0x4a, 0x64,
		      0x9a, 0x93, 0xc8, 0x7c, 0xf3, 0x8f, 0x41, 0x81),
};

/* Scan respond OpenThread Settings GATT service's UUID */
static const struct bt_data scan_resp_ot[] = {
	BT_DATA_BYTES(BT_DATA_UUID128_SOME,
		      0x30, 0x0d, 0x90, 0xb4, 0x7b, 0x81, 0xec, 0x9b,
	              0x41, 0xd4, 0x9a, 0xaa, 0x9c, 0xe4, 0xa9, 0xa8),
};

static void advertise(const struct bt_data *adv,
		      const struct bt_data *scan_resp)
{
	int err;

	bt_le_adv_stop();

	/* Using ad_inet6 as default size for all advertises */
	/* Using scan_resp_ot as default size for all scan responses */
	err = bt_le_adv_start(BT_LE_ADV_CONN_NAME,
			      adv, ARRAY_SIZE(ad_inet6),
			      scan_resp, ARRAY_SIZE(scan_resp_ot));
	if (err) {
		LOG_ERR("Advertising failed to start (err %d)", err);
	}
}

static void connected(struct bt_conn *conn, u8_t err)
{
	active_conn = true;

	if (err) {
		LOG_ERR("Connection failed (err %u)", err);
	} else {
		LOG_DBG("Connected");
	}
}

static void disconnected(struct bt_conn *conn, u8_t reason)
{
	active_conn = false;
	LOG_DBG("Disconnected (reason %u)", reason);
}

static struct bt_conn_cb conn_callbacks = {
	.connected = connected,
	.disconnected = disconnected,
};

static void pairing_complete_cb(struct bt_conn *conn, bool bonded)
{
	LOG_DBG("Pairing complete: %d", bonded);
}

static void pairing_failed_cb(struct bt_conn *conn)
{
	LOG_DBG("Pairing failed!");
	bt_conn_disconnect(conn, BT_HCI_ERR_AUTHENTICATION_FAIL);
}

static struct bt_conn_auth_cb auth_cb = {
	.pairing_complete = pairing_complete_cb,
	.pairing_failed = pairing_failed_cb,
};

static void ot_updated(void)
{
	static bool ot_nvs_wiped = false;

	LOG_DBG("OpenThread value updated");

	if (ot_nvs_wiped == false) {
		clear_ot_nvs();
		ot_nvs_wiped = true;
	}
}

int bt_srv_init(void)
{
	int err;

	active_conn = false;

	/* Peer's IPV6 GATT service */
	err = gatt_inet6_init();
	if (err) {
		LOG_ERR("Peer's IPV6 Config GATT service init failed (err %d)", err);
		return err;
	}

	/* Control device GATT service */
	err = gatt_ctrl_init();
	if (err) {
		LOG_ERR("Control device GATT service"\
			" init failed (err %d)", err);
		return err;
	}

	/* Set OpenThread value updated callback */
	setup_ot_updated_cb_register(&ot_updated);

#ifdef CONFIG_MCUMGR_CMD_IMG_MGMT
	img_mgmt_register_group();
#endif

	err = bt_enable(NULL);
	if (err) {
		LOG_ERR("Bluetooth enable failed (err %d)", err);
		return err;
	}
	LOG_DBG("Bluetooth initialized");

	bt_conn_cb_register(&conn_callbacks);
	bt_conn_auth_cb_register(&auth_cb);

	/* Initialize the Bluetooth mcumgr transport. */
	smp_bt_register();

	settings_load();

	LOG_INF("Bluetooth ready for advertising...");

	return 0;
}

/* Alternate advertising if not connected */
void bt_srv_toggle_advertising(void)
{
	const struct bt_data *adv_tmp;
	const struct bt_data *scan_resp_tmp;
	static s64_t last_toggle_time = 0;
	s64_t current_time;
	static bool adv_bool = false;

	/* Ignore if connected */
	if (active_conn)
		return;

	/* Wait for toggle time */
	current_time = k_uptime_get();
	if (current_time - last_toggle_time < ADVERTISING_TOGGLE_MS)
		return;

	/* Toggle advertising arrays */
	adv_tmp = (adv_bool) ? ad_inet6 : ad_mcumgr;
	scan_resp_tmp = (adv_bool) ? scan_resp_ot : scan_resp_ctrl;

	advertise(adv_tmp, scan_resp_tmp);
	adv_bool = !adv_bool;

	/* Update time */
	last_toggle_time = current_time;
}
```

## src/bt_srv.h
```c
/* bt_services_init.h - Bluetooth services handler */
/*
 * Copyright (c) 2019, CESAR. All rights reserved.
 *
 * Licensed under the Apache License, Version 2.0 (the "License");
 * you may not use this file except in compliance with the License.
 * You may obtain a copy of the License at
 *
 *     http://www.apache.org/licenses/LICENSE-2.0
 *
 * Unless required by applicable law or agreed to in writing, software
 * distributed under the License is distributed on an "AS IS" BASIS,
 * WITHOUT WARRANTIES OR CONDITIONS OF ANY KIND, either express or implied.
 * See the License for the specific language governing permissions and
 * limitations under the License.
 */

int bt_srv_init(bool *reset_signal);

void bt_srv_toggle_advertising(void);
```

## src/gatt_ctrl.c
```c
/* gatt_ctrl.c - GATT service to control device */

/*
 * Copyright (c) 2019, CESAR. All rights reserved.
 *
 * SPDX-License-Identifier: Apache-2.0
 */

#include <zephyr.h>
#include <logging/log.h>

#include <bluetooth/bluetooth.h>
#include <bluetooth/gatt.h>

#include "gatt_ctrl.h"

LOG_MODULE_DECLARE(knot_setup, LOG_LEVEL_DBG);

/* Available commands */
enum {
	CTRL_CMD_UNSET =		0x00,
	CTRL_CMD_RESET =		0x01,
};

static u8_t cmd = CTRL_CMD_UNSET;	// Received command
static bool *out_reset_signal;

/* Custom Service Variables */
static struct bt_uuid_128 service_uuid = BT_UUID_INIT_128(
	0x70, 0xba, 0x2b, 0xfb, 0x05, 0x74, 0x4a, 0x64,
	0x9a, 0x93, 0xc8, 0x7c, 0xf3, 0x8f, 0x41, 0x81);
static const struct bt_uuid_128 cmd_uuid = BT_UUID_INIT_128(
	0x71, 0xba, 0x2b, 0xfb, 0x05, 0x74, 0x4a, 0x64,
	0x9a, 0x93, 0xc8, 0x7c, 0xf3, 0x8f, 0x41, 0x81);

static void process_cmd()
{
	if (cmd == CTRL_CMD_RESET)
		*out_reset_signal = true;
}

/* Write characteristic callback function */
static ssize_t write_cmd(struct bt_conn *conn, const struct bt_gatt_attr *attr,
			 const void *buf, u16_t len, u16_t offset, u8_t flags)
{
	u8_t *value = attr->user_data;
	u16_t max_len = sizeof(cmd);

	if (offset + len > max_len)
		return BT_GATT_ERR(BT_ATT_ERR_INVALID_OFFSET);

	if (offset == 0)
		memset(value, 0, max_len);

	memcpy(value + offset, buf, len);

	process_cmd();

	return len;
}

/* Config GATT Service Declaration */
static struct bt_gatt_attr config_gatt_attrs[] = {
	/* Primary Service Declaration */
	BT_GATT_PRIMARY_SERVICE(&service_uuid),
	BT_GATT_CHARACTERISTIC(&cmd_uuid.uuid,
			       BT_GATT_CHRC_WRITE,
			       BT_GATT_PERM_WRITE,
			       NULL, write_cmd,
			       &cmd),
};

static struct bt_gatt_service config_svc = BT_GATT_SERVICE(config_gatt_attrs);

int gatt_ctrl_init(bool *reset_signal)
{
	int err;

	/* GATT service start */
	err = bt_gatt_service_register(&config_svc);
	if (err) {
		LOG_ERR("GATT service init failed (err %d)", err);
		return err;
	}

	/* Set signals to be used */
	out_reset_signal = reset_signal;

	return 0;
}
```

## src/gatt_ctrl.h
```c
/* gatt_ctrl.h - GATT service to control device */

/*
 * Copyright (c) 2019, CESAR. All rights reserved.
 *
 * SPDX-License-Identifier: Apache-2.0
 */

int gatt_ctrl_init(void);
```

## src/gatt_inet6.c
```c
/* gatt_inet6.c - Callbacks and definition for Peer's IPV6 GATT service */

/*
 * Copyright (c) 2019, CESAR. All rights reserved.
 *
 * SPDX-License-Identifier: Apache-2.0
 */

#include <zephyr.h>
#include <logging/log.h>

#include <bluetooth/bluetooth.h>
#include <bluetooth/gatt.h>

#include "gatt_inet6.h"
#include "storage.h"

/* Buffer len */
#define PEER_IPV6_LEN 40

LOG_MODULE_DECLARE(knot_setup, LOG_LEVEL_DBG);

static char peer_ipv6[PEER_IPV6_LEN];	// Peer's Ipv6

/* Custom Service Variables */
static struct bt_uuid_128 config_service_uuid = BT_UUID_INIT_128(
	0x70, 0x14, 0x1c, 0xbe, 0xdd, 0xe6, 0x5a, 0xb3,
	0x8b, 0x49, 0xb4, 0x5d, 0x83, 0x11, 0x60, 0x49);
static const struct bt_uuid_128 peer_ipv6_uuid = BT_UUID_INIT_128(
	0x71, 0x14, 0x1c, 0xbe, 0xdd, 0xe6, 0x5a, 0xb3,
	0x8b, 0x49, 0xb4, 0x5d, 0x83, 0x11, 0x60, 0x49);

/* Read characteristic generic function */
static ssize_t read_ipv6(struct bt_conn *conn, const struct bt_gatt_attr *attr,
			 void *buf, u16_t len, u16_t offset)
{
	char *value = attr->user_data;
	u16_t max_len;
	int rc;

	rc = storage_read(STORAGE_PEER_IPV6, peer_ipv6, sizeof(peer_ipv6));
	if (rc != sizeof(peer_ipv6))
		return BT_GATT_ERR(BT_ATT_ERR_NOT_SUPPORTED);

	max_len = strlen(peer_ipv6);
	return bt_gatt_attr_read(conn, attr, buf, len, offset, value, max_len);
}

/* Write characteristic callback function */
static ssize_t write_ipv6(struct bt_conn *conn, const struct bt_gatt_attr *attr,
			 const void *buf, u16_t len, u16_t offset, u8_t flags)
{
	u8_t *value = attr->user_data;
	u16_t max_len = sizeof(peer_ipv6) - 1;	// Last byte preserved for '\0'
	static char build_peer_ipv6[PEER_IPV6_LEN]; // Peer's Ipv6 build buffer
	int rc;

	if (offset + len > max_len)
		return BT_GATT_ERR(BT_ATT_ERR_INVALID_OFFSET);

	if (offset == 0)
		memset(build_peer_ipv6, 0, max_len);

	memcpy(build_peer_ipv6 + offset, buf, len);

	/* Check for prepare write flag */
	if (flags & BT_GATT_WRITE_FLAG_PREPARE)
		return 0;

	/* Store value at "peer_ipv6", pointed as "value" */
	memcpy(value, build_peer_ipv6, PEER_IPV6_LEN);
	rc = storage_write(STORAGE_PEER_IPV6, build_peer_ipv6, PEER_IPV6_LEN);

	if (rc != PEER_IPV6_LEN)
		return BT_GATT_ERR(BT_ATT_ERR_NOT_SUPPORTED);

	return len;
}

/* Config GATT Service Declaration */
static struct bt_gatt_attr config_gatt_attrs[] = {
	/* Vendor Primary Service Declaration */
	BT_GATT_PRIMARY_SERVICE(&config_service_uuid),
	BT_GATT_CHARACTERISTIC(&peer_ipv6_uuid.uuid,
			       BT_GATT_CHRC_READ | BT_GATT_CHRC_WRITE,
			       BT_GATT_PERM_READ |
			       BT_GATT_PERM_WRITE |
			       BT_GATT_PERM_PREPARE_WRITE,
			       read_ipv6, write_ipv6, peer_ipv6),
};

static struct bt_gatt_service config_svc = BT_GATT_SERVICE(config_gatt_attrs);

int gatt_inet6_init(void)
{
	int err;

	/* GATT service start */
	err = bt_gatt_service_register(&config_svc);
	if (err) {
		LOG_ERR("GATT service init failed (err %d)", err);
		return err;
	}

	return 0;
}
```

## src/gatt_inet6.h
```c
/* gatt_inet6.h - Callbacks and definition for Config's GATT service */

/*
 * Copyright (c) 2019, CESAR. All rights reserved.
 *
 * SPDX-License-Identifier: Apache-2.0
 */

int gatt_inet6_init(void);
```

## src/peripheral.c
```c
/* peripheral.c - Peripherals handler */

/*
 * Copyright (c) 2019, CESAR. All rights reserved.
 *
 * Licensed under the Apache License, Version 2.0 (the "License");
 * you may not use this file except in compliance with the License.
 * You may obtain a copy of the License at
 *
 *     http://www.apache.org/licenses/LICENSE-2.0
 *
 * Unless required by applicable law or agreed to in writing, software
 * distributed under the License is distributed on an "AS IS" BASIS,
 * WITHOUT WARRANTIES OR CONDITIONS OF ANY KIND, either express or implied.
 * See the License for the specific language governing permissions and
 * limitations under the License.
 */

#include <zephyr.h>
#include <device.h>
#include <gpio.h>
#include "peripheral.h"

/* Button GPIO Controller */
#define BUTTON_GPIO		SW0_GPIO_CONTROLLER
#define BUTTON_PIN		SW0_GPIO_PIN

/* LEDs GPIO Controllers */
#define LED0_GPIO		LED0_GPIO_CONTROLLER
#define LED0_PIN		LED0_GPIO_PIN
#define LED1_GPIO		LED1_GPIO_CONTROLLER
#define LED1_PIN		LED1_GPIO_PIN

#define LED_TOGGLE_PERIOD	500 /* Led toggle period in ms*/

static struct device *gpio_button = NULL;
static struct device *gpio_led_dev[2];
static char *gpio_led_name[2] = {LED0_GPIO, LED1_GPIO};
static u32_t gpio_led_pin[2] = {LED0_PIN, LED1_PIN};

/*
 * Configure button pin as a pulled up input pin.
 * The button pin is defined by BUTTON_PIN macro.
 */
static int configure_button(void)
{
	/* Find device */
	gpio_button = device_get_binding(BUTTON_GPIO);
	if (!gpio_button)
		return -1;

	/* Configure button */
	return gpio_pin_configure(gpio_button, BUTTON_PIN,
				  GPIO_DIR_IN |
				  GPIO_PUD_PULL_UP);
}

/*
 * Configure LED as output pin.
 */
static int configure_led(const char *name, const u32_t pin, struct device **dev)
{
	/* Configure LEDs */
	*dev = device_get_binding(name);

	if (!*dev)
		return -1;

	return gpio_pin_configure(*dev, pin, GPIO_DIR_OUT);
}

/*
 * Configure peripherals.
 * Return 0 in case of success
 */
int peripheral_init(void)
{
	int rc;

	rc = configure_button();
	if (rc)
		return rc;

	/* Configure LEDs */
	rc = configure_led(gpio_led_name[0], gpio_led_pin[0], &gpio_led_dev[0]);
	if (rc)
		return rc;

	rc = configure_led(gpio_led_name[1], gpio_led_pin[1], &gpio_led_dev[1]);
	return rc;
}

/*
 * Read actual status of button.
 *
 * @return	 0 button pressed
 *		 1 button not pressed
 *		-1 GPIO error
 */

int peripheral_btn_status(void)
{
	int val;
	int rc;

	/* Fail if port not defined */
	if (!gpio_button)
		return PERIPHERAL_BTN_ERROR;

	/* Read pin value */
	rc = gpio_pin_read(gpio_button, BUTTON_PIN, &val);

	/* Return error if no device found */
	if (rc)
		return PERIPHERAL_BTN_ERROR;

	return val;
}

void peripheral_toggle_led(void)
{
	static s64_t last_toggle_time = 0;
	s64_t current_time;
	static bool led_state = false;

	/* Wait for toggle time */
	current_time = k_uptime_get();
	if (current_time - last_toggle_time < LED_TOGGLE_PERIOD)
		return;

	/* Toggle led */
	gpio_pin_write(gpio_led_dev[0], gpio_led_pin[0],  led_state);
	gpio_pin_write(gpio_led_dev[1], gpio_led_pin[1], !led_state);

	led_state = !led_state;

	/* Update time */
	last_toggle_time = current_time;
}
```

## src/peripheral.h
```c
/* peripheral.h - Peripherals handler */

/*
 * Copyright (c) 2019, CESAR. All rights reserved.
 *
 * SPDX-License-Identifier: Apache-2.0
 */

/*
 * Helper defines and function to ease peripherals handling.
 * Built based on nrf52840_pca10056 board.
 */

int peripheral_init(void);
int peripheral_btn_status(void);
void peripheral_toggle_led(void);

enum {
	PERIPHERAL_BTN_PRESSED = 0,
	PERIPHERAL_BTN_NOT_PRESSED = 1,
	PERIPHERAL_BTN_ERROR = -1
};
```
